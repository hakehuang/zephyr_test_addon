## CMakeLists.txt
```
# Copyright (c) 2021, Legrand North America, LLC.
# SPDX-License-Identifier: Apache-2.0

cmake_minimum_required(VERSION 3.20.0)
find_package(Zephyr REQUIRED HINTS $ENV{ZEPHYR_BASE})
project(app_lib_custom_sample)

target_sources(app PRIVATE src/main.c)
```

## sample.yaml
```
sample:
  description: Custom library sample
  name: custom-lib-sample
common:
  tags: extensibility
  integration_platforms:
    - custom_plank
    - qemu_cortex_m3
tests:
  sample.lib.custom: {}
```

## prj.conf
```kconfig
# Copyright (c) 2021, Legrand North America, LLC.
# SPDX-License-Identifier: Apache-2.0

CONFIG_CUSTOM=y
```

## src/main.c
```c
/*
 * Copyright (c) 2021, Legrand North America, LLC.
 *
 * SPDX-License-Identifier: Apache-2.0
 */

#include <zephyr/kernel.h>
#include <zephyr/sys/printk.h>

#include <app/lib/custom.h>

int main(void)
{
	printk("Custom library sample\n");

	printk("custom_get_value(0) = %d\n", custom_get_value(0));
	printk("custom_get_value(1) = %d\n", custom_get_value(1));
	printk("custom_get_value(42) = %d\n", custom_get_value(42));

	return 0;
}
```
